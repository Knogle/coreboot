## src/mainboard/asrockrack/b565d4_v1l/Kconfig.name
```kconfig
## SPDX-License-Identifier: GPL-2.0-only

config BOARD_ASROCKRACK_B565D4_V1L
	bool "B565D4-V1L (Cezanne native)"
```

## src/soc/amd/common/block/apob/Kconfig
```kconfig
## SPDX-License-Identifier: GPL-2.0-only

config SOC_AMD_COMMON_BLOCK_APOB
	bool
	help
	  Select this option to add firmware support for the non-volatile APOB
	  cache to the build.

config SOC_AMD_COMMON_BLOCK_APOB_NV_DISABLE
	bool "Disable non-volatile APOB support"
	depends on SOC_AMD_COMMON_BLOCK_APOB
	help
	  Select this to disable non-volatile APOB cache and train memory
	  on every boot.

	  If unsure, say N.

config SOC_AMD_COMMON_BLOCK_APOB_HASH
	bool
	help
	  Select this to use a hash of the APOB data to determine when to update
	  the non-volatile APOB store.

config SOC_AMD_COMMON_BLOCK_VERMEER_APOB_SPD
	bool
	help
	  Decode the bounded Vermeer APOB cached-SPD record. The decoder only
	  validates the record structure and copies raw SPD bytes; mainboards
	  remain responsible for board-specific normalization and validation.
```

## src/soc/amd/common/block/nbio/Kconfig
```kconfig
## SPDX-License-Identifier: GPL-2.0-only

config SOC_AMD_COMMON_BLOCK_MATISSE_NBIO
	bool
	help
	  Build the native Matisse NBIO planning helpers.

config SOC_AMD_COMMON_BLOCK_MATISSE_DXIO
	bool
	select SOC_AMD_COMMON_BLOCK_MATISSE_NBIO
	help
	  Build the native Matisse DXIO protocol and state machines.

config SOC_AMD_COMMON_BLOCK_MATISSE_PORT_VISIBILITY
	bool
	select SOC_AMD_COMMON_BLOCK_MATISSE_NBIO
	help
	  Hide unused Matisse root ports after PCI enumeration while retaining
	  discovered, training and hotplug links.
```

## src/soc/amd/common/block/smu/Kconfig
```kconfig
## SPDX-License-Identifier: GPL-2.0-only

config SOC_AMD_COMMON_BLOCK_SMU
	bool
	select SOC_AMD_COMMON_BLOCK_SMN
	help
	  Select this option to add functions to communicate with the SMU to the build.

config SOC_AMD_COMMON_BLOCK_VERMEER_SMU_POWERPLAY
	bool
	depends on SOC_AMD_COMMON_BLOCK_SMU
	help
	  Import a board-supplied PowerPlay table through the qualified
	  Vermeer SMU interface.

config SOC_AMD_COMMON_BLOCK_VERMEER_SMU_CPPC
	bool
	depends on SOC_AMD_COMMON_BLOCK_SMU
	help
	  Initialize the qualified Vermeer CPPC service and read its
	  capability and frequency description.

config SOC_AMD_COMMON_BLOCK_VERMEER_SMU_PCC
	bool
	depends on SOC_AMD_COMMON_BLOCK_SMU
	select SOC_AMD_COMMON_BLOCK_ACPI_VERMEER_PCC
	help
	  Register and probe the qualified Vermeer CPPC PCC shared-memory
	  interface.

config SOC_AMD_COMMON_BLOCK_VERMEER_SMU_TELEMETRY
	bool
	depends on SOC_AMD_COMMON_BLOCK_SMU
	help
	  Register the qualified Vermeer SMU telemetry owner in CBMEM.

config SOC_AMD_COMMON_BLOCK_SMU_SX_ENTRY
	bool
	depends on SOC_AMD_COMMON_BLOCK_SMU
	help
	  Select this option to add the function to send the S3/4/5 entry
	  message to the SMU.
```

## src/soc/amd/common/block/usb/Kconfig
```kconfig
## SPDX-License-Identifier: GPL-2.0-only

config SOC_AMD_COMMON_BLOCK_MATISSE_USB
	bool
	select SOC_AMD_COMMON_BLOCK_SMU
	help
	  Build the native Matisse USB policy and SMU request service.
```
